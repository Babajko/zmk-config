## boards/shields/oled_ch1115_128x64/Kconfig.defconfig
```kconfig
# Copyright (c) 2024 The ZMK Contributors
# SPDX-License-Identifier: MIT

if SHIELD_OLED_CH1115_128X64

config ZMK_DISPLAY
    select LVGL_USE_LABEL
    select LVGL_USE_IMG
    select LVGL_FONT_MONTSERRAT_26
    select LVGL_FONT_UNSCII_8

if ZMK_DISPLAY

config I2C
    default y

endif # ZMK_DISPLAY

endif # SHIELD_OLED_CH1115_128X64
```

## boards/shields/oled_ch1115_128x64/Kconfig.shield
```kconfig
# Copyright (c) 2024 The ZMK Contributors
# SPDX-License-Identifier: MIT

config SHIELD_OLED_CH1115_128X64
    def_bool $(shields_list_contains,oled_ch1115_128x64)
```

## config/west.yml
```yaml
manifest:
  remotes:
    - name: zmkfirmware
      url-base: https://github.com/zmkfirmware
    - name: Babajko
      url-base: https://github.com/Babajko
    # - name: mctechnology17
    #   url-base: https://github.com/mctechnology17
  projects:
    - name: zmk
      remote: zmkfirmware
      revision: main
      import: app/west.yml
    - name: zmk-oled-adapter
      remote: Babajko
      revision: main
    # - name: zmk-nice-oled
    #  remote: mctechnology17
    #  revision: main
  self:
    path: config
```

## sh1107-module/Kconfig
```kconfig
# SH1107 display module Kconfig

menuconfig SH1107
	bool "SH1107 OLED display driver"
	default y
	depends on DT_HAS_SINOWEALTH_SH1107_ENABLED
	select I2C if $(dt_compat_on_bus,$(DT_COMPAT_SINOWEALTH_SH1107),i2c)
	select SPI if $(dt_compat_on_bus,$(DT_COMPAT_SINOWEALTH_SH1107),spi)
	help
	  Enable driver for SH1107 OLED display controller.
	  Supports I2C and SPI interfaces.
	  Common resolutions: 64x128, 128x128.

if SH1107

config SH1107_DEFAULT_CONTRAST
	int "SH1107 default contrast"
	default 127
	range 0 255
	help
	  Default contrast level for SH1107 display.

endif # SH1107
```

## sh1107-module/boards/shields/sh1107_64x128/Kconfig.defconfig
```kconfig
if SHIELD_SH1107_64X128

config LV_Z_VDB_SIZE
    default 100

config LV_Z_FULL_REFRESH
    default y

config LV_DPI_DEF
    default 148

config LV_Z_BITS_PER_PIXEL
    default 1

choice LV_COLOR_DEPTH
    default LV_COLOR_DEPTH_1
endchoice

choice ZMK_DISPLAY_STATUS_SCREEN
    default ZMK_DISPLAY_STATUS_SCREEN_CUSTOM
endchoice

config LV_Z_MEM_POOL_SIZE
    default 4096 if ZMK_DISPLAY_STATUS_SCREEN_CUSTOM

config LV_USE_LABEL
    default y

config I2C
    default y

config SH1107
    default y

endif # SHIELD_SH1107_64X128
```

## sh1107-module/dts/bindings/display/sinowealth,sh1107-common.yaml
```yaml
# Copyright (c) 2024
# SPDX-License-Identifier: GPL 

description: |
  SH1107 OLED display controller common properties.
  Supports 64x128, 128x128 configurations.

include: display-controller.yaml

properties:
  width:
    type: int
    required: true
    description: Display width in pixels (typically 64 or 128)

  height:
    type: int
    required: true
    description: Display height in pixels (typically 128)

  segment-offset:
    type: int
    default: 0
    description: Column offset for RAM to SEG mapping

  page-offset:
    type: int
    default: 0
    description: Page start offset (each page = 8 rows)

  display-offset:
    type: int
    default: 0
    description: |
      Display offset (0x00-0x7F). Maps display start line to COM0 + offset.
      For 64x128 displays typically 96 (0x60).

  multiplex-ratio:
    type: int
    default: 127
    description: Multiplex ratio. Set to (height - 1).

  segment-remap:
    type: boolean
    description: Map column address 127 to SEG0 (flip horizontally)

  com-invdir:
    type: boolean
    description: Invert COM scan direction (flip vertically)

  prechargep:
    type: int
    default: 0x22
    description: Pre-charge period (phase1 in lower nibble, phase2 in upper)

  contrast:
    type: int
    default: 0x80
    description: Initial contrast value (0x00-0xFF)

  clock-div-ratio:
    type: int
    default: 0x51
    description: Clock divide ratio and oscillator frequency

  vcom-deselect:
    type: int
    default: 0x35
    description: VCOM deselect level

  inversion-on:
    type: boolean
    description: Enable display inversion mode

  dcdc-on:
    type: boolean
    description: Enable internal DC-DC charge pump (default on)
```

## sh1107-module/dts/bindings/display/sinowealth,sh1107-i2c.yaml
```yaml
# Copyright (c) 2024
# SPDX-License-Identifier: GPL 

description: SH1107 OLED display controller on I2C bus

compatible: "sinowealth,sh1107"

include: ["sinowealth,sh1107-common.yaml", "i2c-device.yaml"]
```
